## build/conf/bblayers.conf
```bitbake
# LAYER_CONF_VERSION is increased each time build/conf/bblayers.conf
# changes incompatibly
LCONF_VERSION = "6"

BBPATH = "${TOPDIR}"
BBFILES ?= ""

#BBLAYERS ?= " \
#  /home/abesis/cubie/yocto/poky/meta \
#  /home/abesis/cubie/yocto/poky/meta-yocto \
#  /home/abesis/cubie/yocto/poky/meta-yocto-bsp \
#  "
BBLAYERS_NON_REMOVABLE ?= " \
  /home/abesis/cubie/yocto/poky/meta \
  /home/abesis/cubie/yocto/poky/meta-yocto \
  "
#added by hob
BBFILES += "${TOPDIR}/recipes/images/custom/*.bb"
#added by hob
BBFILES += "${TOPDIR}/recipes/images/*.bb"

#added by hob
BBLAYERS = "/home/abesis/cubie/yocto/poky/meta /home/abesis/cubie/yocto/poky/meta-yocto /home/abesis/cubie/yocto/poky/meta-yocto-bsp /home/abesis/cubie/yocto/poky/meta-sunxi /home/abesis/cubie/yocto/poky/meta-abesis"
```

## meta-abesis/conf/machine/and070.conf
```bitbake
#@TYPE: Machine
#@NAME: AND070
#@DESCRIPTION: Machine configuration for the ABESiS AND070, based on allwinner A20 CPU http://abesis.net/

require conf/machine/include/sun7i.inc

# PREFERRED_PROVIDER_virtual/kernel = "linux"
# PREFERRED_PROVIDER_u-boot = "u-boot-sunxi"
# PREFERRED_PROVIDER_virtual/bootloader = "u-boot-sunxi"

KERNEL_DEVICETREE = "sun7i-a20-cubieboard2.dtb"
UBOOT_MACHINE = "Cubieboard2_config"
SUNXI_FEX_FILE = "sys_config/a20/and070.fex"
```
